/*******************************(C) COPYRIGHT 2017 Wind（谢玉伸）*********************************/
/**============================================================================
* @FileName    : OS_Manage.c
* @Description : 系统管理
* @Date        : 2017/10/16
* @By          : Wind（谢玉伸）
* @Email       : 1659567673@qq.com
* @Platform    : Keil uVision5 v5.15 (STM32L151CB)
* @Explain     :  
------------------------------------------------------------------------------- 
修订记录：	
 @Date		@Version			@Revise					@Author
2017/10/16	V1.1.1				增添常用函数				Wind（谢玉伸）
2017/11/03	V1.1.2				增加休眠功能				Wind（谢玉伸）

最后修订：  
1.增加休眠功能	
2.删除不常用的状态修改函数，大家可以在变量内直接修改。
*=============================================================================*/        

/* 需要头文件 ----------------------------------------------------------------*/
#include "OS_Manage.h"

/* 私有宏定义 ----------------------------------------------------------------*/

/* 私有（静态）函数声明 ------------------------------------------------------*/ 

/* 全局变量定义 --------------------------------------------------------------*/
/* App --------------------------------------------*/
TypeStruct_AppList AppHead[OS_THREAD_MAX] = {NULL}; //定义任务堆头       

/* 全局函数编写 --------------------------------------------------------------*/ 
/**----------------------------------------------------------------------------
* @FunctionName  : OSTask_Creat()     
* @Description   : 任务创建 
* @Data          : 2016/3/16
* @Explain       : 
-------------------------------------------------------------------------------
_AppList：App地址    
返回值 	：  
0.成功	
1.不存在该线程	
2.该任务已在该线程里
------------------------------------------------------------------------------*/	
uint8_t OSTask_Creat(TypeStruct_AppList *_AppList) 				   
{  
	if(_AppList ->thread >= OS_THREAD_MAX) return 1;//不存在该线程 
	
	TypeStruct_AppList *Temp = &AppHead[_AppList ->thread];   
	
	while(Temp ->next != NULL)
	{
		Temp = Temp ->next;	 	
		if(Temp == _AppList) return 2;
	}	
	
	Temp ->next = _AppList;       	 
	_AppList ->next = NULL; //任务插在堆尾   		
	
	return 0;  
}	



/**----------------------------------------------------------------------------
* @FunctionName  : OSTask_Remove()     
* @Description   : 任务删除 
* @Data          : 2016/3/16		
* @Explain       :    
-------------------------------------------------------------------------------
_AppAddr = 程序地址 
返回值 	：
0.成功
1.删除任务失败				
------------------------------------------------------------------------------*/	
uint8_t OSTask_Remove(TypeStruct_AppList *_AppList)    
{   
	if(_AppList ->thread >= OS_THREAD_MAX) return 1;//不存在该线程 
	
	TypeStruct_AppList *Temp = &AppHead[_AppList ->thread];   
	
	while(Temp ->next != NULL)
	{
		Temp = Temp ->next;	 	
		if(Temp ->next == _AppList) break; //找到 pStruct 上一个任务的地址
	}	
	
	Temp ->next = _AppList ->next;  	  
	_AppList ->next = NULL;
	
	return 0;		
}  

/**----------------------------------------------------------------------------
* @FunctionName  : OSTask_State()     
* @Description   : 任务状态修改
* @Data          : 2016/3/22		
* @Explain       : 
------------------------------------------------------------------------------- 
_AppAddr = 程序地址 
返回值 ：0.成功
------------------------------------------------------------------------------*/
inline uint8_t OSTask_State(TypeStruct_AppList *_AppList,TypeEnum_OS_State _State)  
{      			 	
	/* 修改数据 -----------------------------------*/		 	
	_AppList ->state = _State;		
	
	return 0;				
}

/**----------------------------------------------------------------------------
* @FunctionName  : OSTask_Close()     
* @Description   : 关闭任务
* @Data          : 2016/3/22		
* @Explain       : 
-------------------------------------------------------------------------------
_AppAddr = 程序地址     
返回值 ：0.成功
------------------------------------------------------------------------------*/
inline uint8_t OSTask_Close(TypeStruct_AppList *_AppList)  
{      
	/* 修改数据 -----------------------------------*/		 	
	_AppList ->state = OS_STATE_CLOSE;		
			 
	return 0;				
}


/**----------------------------------------------------------------------------
* @FunctionName  : OSTask_Active()     
* @Description   : 激活任务
* @Data          : 2016/3/22		
* @Explain       : 
-------------------------------------------------------------------------------
_AppAddr	：程序地址     
返回值 		：0.成功
------------------------------------------------------------------------------*/
inline uint8_t OSTask_Active(TypeStruct_AppList *_AppList)  
{      
	/* 修改数据 -----------------------------------*/		 	
	_AppList ->state = OS_STATE_ACTIVE;		
	_AppList ->sleep = 0; //退出睡眠	 
	return 0;				
}


/**----------------------------------------------------------------------------
* @FunctionName  : OSRunning_Break()     	
* @Description   : 打断运行	
* @Data          : 2016/3/23		
* @Explain       : None 		
------------------------------------------------------------------------------*/
inline uint8_t OSRunning_Break(void) 
{
	OS_Msg |= OS_BREAK; 
	return 0;
}
												
											
/**----------------------------------------------------------------------------
* @FunctionName  : OSRunning_GoOn()     
* @Description   : 继续运行		
* @Data          : 2016/3/23		
* @Explain       : None		
------------------------------------------------------------------------------*/
inline uint8_t OSRunning_Continue(void) 
{ 
	OS_Msg &= ~OS_BREAK; 
	return 0; 
}

/**----------------------------------------------------------------------------
* @FunctionName  : OSTask_Sleep()     
* @Description   : 任务睡眠
* @Data          : 2017/11/03
* @Explain       : 
-------------------------------------------------------------------------------
_AppAddr	：程序地址     
Sleep		：睡眠时间 单位：ms
返回值 		：0.成功
------------------------------------------------------------------------------*/
inline uint8_t OSTask_Sleep(TypeStruct_AppList *_AppList,uint32_t Sleep)  
{      
	/* 修改数据 -----------------------------------*/		 	
	_AppList ->sleep = Sleep;		
	_AppList ->state = OS_STATE_CLOSE_SLEEP;
	
	return 0;				
}

/*******************************(C) COPYRIGHT 2017 Wind（谢玉伸）*********************************/





